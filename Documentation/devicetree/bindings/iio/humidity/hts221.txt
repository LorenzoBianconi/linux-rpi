## Documentation/devicetree/bindings/iio/humidity/hts221.txt
```
* HTS221 STM humidity/temperature sensor

Required properties:
- compatible: should be "st,hts221"

Optional properties:
- interrupts: interrupt mapping for IRQ
- interrupt-parent: should be the phandle for the interrupt controller

Example:

hts221@5f {
	compatible = "st,hts221";
	reg = <0x5f>;
	interrupt-parent = <&gpio0>;
	interrupts = <0 IRQ_TYPE_EDGE_RISING>;
};
```

## Documentation/devicetree/bindings/iio/imu/st_lsm6dsx.txt
```
* ST_LSM6DSX driver for LSM6DS3-LSM6DSM accel/gyro Mems sensor

Required properties:
- compatible: must be one of:
  "st,lsm6ds3"
  "st,lsm6dsm"

Optional properties:
- interrupts: interrupt mapping for IRQ
- interrupt-parent: should be the phandle for the interrupt controller

Example:

lsm6dsm@6b {
	compatible = "st,lsm6dsm";
	reg = <0x6b>;
	interrupt-parent = <&gpio0>;
	interrupts = <0 IRQ_TYPE_EDGE_RISING>;
};
```

## drivers/iio/humidity/hts221/Kconfig
```kconfig
config HTS221
	tristate "STMicroelectronics HTS221 sensor Driver"
	depends on (I2C || SPI)
	select IIO_BUFFER
	select IIO_TRIGGERED_BUFFER
	select HTS221_I2C if (I2C)
	select HTS221_SPI if (SPI_MASTER)
	help
	  Say yes here to build support for STMicroelectronics HTS221
	  temperature-humidity sensor

	  To compile this driver as a module, choose M here: the module
	  will be called hts221.

config HTS221_I2C
	tristate
	depends on HTS221

config HTS221_SPI
	tristate
	depends on HTS221
```

## drivers/iio/imu/st_lsm6dsx/Kconfig
```kconfig
config IIO_ST_LSM6DSX
	tristate "STMicroelectronics LSM6DSX sensor driver"
	depends on (I2C || SPI) && SYSFS
	select IIO_BUFFER
	select IIO_TRIGGERED_BUFFER
	select IIO_ST_LSM6DSX_I2C if (I2C)
	select IIO_ST_LSM6DSX_SPI if (SPI_MASTER)
	help
	  Say yes here to build support for STMicroelectronics LSM6DSX imu
	  sensor. Supported devices: lsm6ds3

	  To compile this driver as a module, choose M here: the module
	  will be called st_lsm6dsx.

config IIO_ST_LSM6DSX_I2C
	tristate
	depends on IIO_ST_LSM6DSX

config IIO_ST_LSM6DSX_SPI
	tristate
	depends on IIO_ST_LSM6DSX
```

## drivers/iio/misc/Kconfig
```kconfig
#
# misc sensor drivers
#
menu "Misc sensors"

config IIO_ST_STILE
	tristate "STMicroelectronics Sensor Tile Driver"
	depends on USB
	select IIO_ST_STILE_USB if (USB)
	select IIO_BUFFER
	select IIO_TRIGGERED_BUFFER
	help
	  Say yes here to build support for STMicroelectronics Sensor Tile
	  9-axis sensor

	  To compile this driver as a module, choose M here: the module
	  will be called st_stile.

config IIO_ST_STILE_USB
	tristate
	depends on IIO_ST_STILE

endmenu
```

## drivers/iio/temperature/hts221/Kconfig
```kconfig
config IIO_HTS221
	tristate "STMicroelectronics HTS221 sensor Driver"
	depends on (I2C || SPI_MASTER) && SYSFS
	select IIO_HTS221_I2C if (I2C)
	select IIO_HTS221_SPI if (SPI_MASTER)
	select IIO_TRIGGERED_BUFFER if (IIO_BUFFER)
	help
	  Say yes here to build support for STMicroelectronics HTS221
	  temperature-humidity sensor

	  To compile this driver as a module, choose M here: the module
	  will be called hts221.

config IIO_HTS221_I2C
	tristate
	depends on IIO_HTS221

config IIO_HTS221_SPI
	tristate
	depends on IIO_HTS221
```
